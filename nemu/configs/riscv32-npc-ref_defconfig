## nemu/configs/riscv32-npc-ref_defconfig
```kconfig
CONFIG_ISA_riscv=y
# CONFIG_RV64 is not set
# CONFIG_RVE is not set
CONFIG_ENGINE_INTERPRETER=y
CONFIG_MODE_SYSTEM=y
# CONFIG_TARGET_NATIVE_ELF is not set
CONFIG_TARGET_SHARE=y
# CONFIG_TARGET_AM is not set
CONFIG_CC_GCC=y
CONFIG_CC_O2=y
# CONFIG_WATCHPOINT is not set
# CONFIG_TRACE is not set
CONFIG_MBASE=0x80000000
CONFIG_MSIZE=0x8000000
CONFIG_PMEM_GARRAY=y
# CONFIG_MEM_RANDOM is not set
# CONFIG_DEVICE is not set
CONFIG_TIMER_GETTIMEOFDAY=y
CONFIG_RT_CHECK=y
```

## nemu/configs/riscv32-ysyxsoc-ref_defconfig
```kconfig
CONFIG_ISA_riscv=y
# CONFIG_RV64 is not set
# CONFIG_RVE is not set
CONFIG_ENGINE_INTERPRETER=y
CONFIG_MODE_SYSTEM=y
# CONFIG_TARGET_NATIVE_ELF is not set
CONFIG_TARGET_SHARE=y
# CONFIG_TARGET_AM is not set
CONFIG_CC_GCC=y
CONFIG_CC_O2=y
# CONFIG_WATCHPOINT is not set
# CONFIG_TRACE is not set
CONFIG_MBASE=0x20000000
CONFIG_MSIZE=0x1000
CONFIG_YSYXSOC_MEMORY=y
CONFIG_YSYXSOC_SDRAM_128MB=y
CONFIG_PMEM_MALLOC=y
# CONFIG_MEM_RANDOM is not set
# CONFIG_DEVICE is not set
CONFIG_TIMER_GETTIMEOFDAY=y
CONFIG_RT_CHECK=y
```

## nemu/src/memory/Kconfig
```kconfig
menu "Memory Configuration"

config MBASE
  hex "Memory base address"
  default 0x0        if ISA_x86
  default 0x80000000

config MSIZE
  hex "Memory size"
  default 0x8000000

config PC_RESET_OFFSET
  hex "Offset of reset vector from the base of memory"
  default 0x100000 if ISA_x86
  default 0

config YSYXSOC_MEMORY
  bool "Enable the discontiguous ysyxSoC physical memory map"
  depends on ISA_riscv && !RV64 && !TARGET_AM
  default n
  help
    Add MROM, SRAM, flash, PSRAM and SDRAM backing stores at the addresses
    exported by ysyxSoC. CONFIG_MBASE still selects the reset vector region.

choice
  prompt "ysyxsoc SDRAM capacity"
  depends on YSYXSOC_MEMORY
  default YSYXSOC_SDRAM_128MB

config YSYXSOC_SDRAM_32MB
  bool "32 MiB (one SDRAM chip)"

config YSYXSOC_SDRAM_64MB
  bool "64 MiB (two-chip bit expansion)"

config YSYXSOC_SDRAM_128MB
  bool "128 MiB (four-chip word expansion)"

endchoice

choice
  prompt "Physical memory definition"
  default PMEM_MALLOC if YSYXSOC_MEMORY
  default PMEM_GARRAY
config PMEM_MALLOC
  bool "Using malloc()"
config PMEM_GARRAY
  depends on !TARGET_AM && !YSYXSOC_MEMORY
  bool "Using global array"
endchoice

config MEM_RANDOM
  depends on MODE_SYSTEM && !DIFFTEST && !TARGET_AM
  bool "Initialize the memory with random values"
  default y
  help
    This may help to find undefined behaviors.

endmenu #MEMORY
```

## npc/Kconfig
```kconfig
mainmenu "NPC Configuration Menu"

choice
	prompt "Simulation platform"
	default NPC_PLATFORM_DIRECT

config NPC_PLATFORM_DIRECT
	bool "Direct NPC"
	help
	  Run the CPU with the lightweight DPI-backed memory and UART wrapper.

config NPC_PLATFORM_YSYXSOC
	bool "ysyxSoC"
	help
	  Build ysyx_24100022 into ysyxSoCFull and use the SoC peripherals.

endchoice

choice
	prompt "RTL simulator"
	default NPC_SIM_VERILATOR
	help
	  Select how the generated RTL is simulated. Verilator is a fast
	  two-value simulator driven by DPI-C, while Icarus Verilog is a
	  four-value simulator that can expose X propagation from registers
	  which are missing a reset.

config NPC_SIM_VERILATOR
	bool "Verilator (DPI-C, two-value)"
	help
	  Build the NPC RTL with Verilator and drive it from the C host through
	  DPI-C. This is the default and supports DiffTest and the SDB.

config NPC_SIM_IVERILOG
	bool "Icarus Verilog (VPI, four-value)"
	depends on NPC_PLATFORM_DIRECT
	help
	  Build the direct NPC RTL with Icarus Verilog and provide the physical
	  memory through a VPI module ($pmem_read/$pmem_write). Icarus Verilog
	  emulates X values so this configuration can be used to find registers
	  which need a reset but do not have one. Only the Direct NPC platform
	  is supported, and DiffTest is not available.

endchoice

config NPC_NETLIST
	bool "Simulate the ECC gate-level netlist (Verilator)"
	depends on NPC_PLATFORM_DIRECT && !NPC_SIM_IVERILOG
	default n
	help
	  Replace the Chisel-generated NPC RTL with the gate-level netlist that
	  ECC produced with yosys. The netlist, the ICsprout55 standard cell
	  behavioral models and NpcTop.sv (which provides the DPI-C memory) are
	  compiled together with Verilator. This checks that the synthesized
	  circuit behaves like the RTL, in particular that the RTL does not
	  contain code that synthesizes differently.

config NPC_NETLIST_FILE
	string "Gate-level netlist (*_Synthesis_sim.v.gz)"
	depends on NPC_NETLIST
	default "../ecc/npc/runs/netlist-sim/Synthesis_yosys/output/npc_Synthesis_sim.v.gz"
	help
	  The simulation-oriented netlist produced by ECC. Its top module keeps
	  the same ports as the RTL NPC module. The file is gunzipped into the
	  build directory before Verilator runs.

config NPC_PDK_ROOT
	string "ICsprout55 PDK root"
	depends on NPC_NETLIST
	default "../icsprout55-pdk"
	help
	  Directory that contains IP/STD_cell/.... The standard cell
	  behavioral simulation models are read from there.

if NPC_PLATFORM_YSYXSOC

choice
	prompt "ysyxSoC boot medium"
	default NPC_YSYXSOC_BOOT_MROM

config NPC_YSYXSOC_BOOT_MROM
	bool "MROM (reset PC 0x20000000)"

config NPC_YSYXSOC_BOOT_FLASH
	bool "Flash XIP (reset PC 0x30000000)"

endchoice

choice
	prompt "ysyxSoC SDRAM capacity"
	default NPC_YSYXSOC_SDRAM_128MB

config NPC_YSYXSOC_SDRAM_32MB
	bool "32 MiB (one SDRAM chip)"

config NPC_YSYXSOC_SDRAM_64MB
	bool "64 MiB (two-chip bit expansion)"

config NPC_YSYXSOC_SDRAM_128MB
	bool "128 MiB (four-chip word expansion)"

endchoice

config NPC_YSYXSOC_CHIPLINK
	bool "Enable the ChipLink peer"
	default n
	help
	  Elaborate the ysyxSoC ChipLink master together with the simulated
	  far-end chip resources.

endif

menu "NPC Debugging"

config NPC_DIFFTEST
	bool "Enable differential testing"
	default n
	help
	  Compare each committed instruction with the configured NEMU reference.

config NPC_DIFFTEST_REF_PATH
	depends on NPC_DIFFTEST
	string "DiffTest reference shared library"
	default "../nemu/build/riscv32-nemu-interpreter-so"

config NPC_ITRACE
	bool "Enable instruction trace"
	default n

config NPC_MTRACE
	bool "Enable memory trace"
	default n

config NPC_FTRACE
	bool "Enable function trace"
	default n
	help
	  Function tracing requires an ELF file at run time.

choice
	prompt "Simulation cycle limit"
	default NPC_MAX_CYCLES_LIMITED

config NPC_MAX_CYCLES_LIMITED
	bool "Set a maximum simulation cycle count"
	help
	  Stop the simulation when the configured number of cycles has elapsed.

config NPC_MAX_CYCLES_UNLIMITED
	bool "Run without a simulation cycle limit"
	help
	  Do not stop the simulation based on its cycle count. Use this for
	  interactive programs that are expected to keep running, such as
	  RT-Thread.

endchoice

config NPC_MAX_CYCLES
	int "Maximum simulation cycles"
	depends on NPC_MAX_CYCLES_LIMITED
	range 1 2147483647
	default 100000000
	help
	  Maximum number of simulated clock cycles before NPC stops the run.
	  A command-line MAX_CYCLES=... value overrides this setting for one run.

config NPC_WAVEFORM
	bool "Generate VCD waveform"
	default n
	help
	  Record every evaluated RTL time step to a VCD file. Waveforms can grow
	  quickly for long-running programs such as RT-Thread, so keep this off
	  for normal runs and use a bounded simulation while debugging.

config NPC_WAVEFORM_FILE
	string "VCD waveform output file"
	depends on NPC_WAVEFORM
	default "build/waveform.vcd"
	help
	  Path of the VCD waveform relative to the NPC directory, or an absolute
	  path. Its parent directory is created before the simulator starts. A
	  command-line WAVEFORM=... value overrides this setting for one run.

endmenu
```

## npc/configs/default_defconfig
```kconfig
CONFIG_NPC_PLATFORM_DIRECT=y
# CONFIG_NPC_PLATFORM_YSYXSOC is not set
# CONFIG_NPC_DIFFTEST is not set
CONFIG_NPC_DIFFTEST_REF_PATH="../nemu/build/riscv32-nemu-interpreter-so"
# CONFIG_NPC_ITRACE is not set
# CONFIG_NPC_MTRACE is not set
# CONFIG_NPC_FTRACE is not set
```

## npc/configs/ysyxsoc_chiplink_defconfig
```kconfig
# CONFIG_NPC_PLATFORM_DIRECT is not set
CONFIG_NPC_PLATFORM_YSYXSOC=y
CONFIG_NPC_YSYXSOC_BOOT_MROM=y
# CONFIG_NPC_YSYXSOC_BOOT_FLASH is not set
# CONFIG_NPC_YSYXSOC_SDRAM_32MB is not set
# CONFIG_NPC_YSYXSOC_SDRAM_64MB is not set
CONFIG_NPC_YSYXSOC_SDRAM_128MB=y
CONFIG_NPC_YSYXSOC_CHIPLINK=y
# CONFIG_NPC_DIFFTEST is not set
CONFIG_NPC_DIFFTEST_REF_PATH="../nemu/build/riscv32-nemu-interpreter-so"
# CONFIG_NPC_ITRACE is not set
# CONFIG_NPC_MTRACE is not set
# CONFIG_NPC_FTRACE is not set
```

## npc/configs/ysyxsoc_flash_difftest_defconfig
```kconfig
# CONFIG_NPC_PLATFORM_DIRECT is not set
CONFIG_NPC_PLATFORM_YSYXSOC=y
# CONFIG_NPC_YSYXSOC_BOOT_MROM is not set
CONFIG_NPC_YSYXSOC_BOOT_FLASH=y
# CONFIG_NPC_YSYXSOC_SDRAM_32MB is not set
# CONFIG_NPC_YSYXSOC_SDRAM_64MB is not set
CONFIG_NPC_YSYXSOC_SDRAM_128MB=y
# CONFIG_NPC_YSYXSOC_CHIPLINK is not set
CONFIG_NPC_DIFFTEST=y
CONFIG_NPC_DIFFTEST_REF_PATH="../nemu/build/riscv32-nemu-interpreter-so"
# CONFIG_NPC_ITRACE is not set
# CONFIG_NPC_MTRACE is not set
# CONFIG_NPC_FTRACE is not set
```
